## rpi_bm/miniOS/Kconfig
```kconfig
mainmenu "miniOS Configuration"

source "src/arch/Kconfig"
source "src/boards/Kconfig"
source "src/drivers/Kconfig"
source "src/fs/Kconfig"

menu "Kernel options"
config USERSPACE
    bool "Userspace and system calls"
    default y

config DEBUG_MMU_DUMP
    bool "Dump MMU page tables"
    default n

config DEBUG_TIMER_TICK
    bool "Print every Timer0 tick"
    default n
endmenu
```

## rpi_bm/miniOS/src/arch/Kconfig
```kconfig
choice
    prompt "Architecture"
    default ARCH_ARM

config ARCH_ARM
    bool "ARM 32-bit"
config ARCH_ARM64
    bool "ARM 64-bit"
endchoice

source "src/arch/arm/Kconfig"
source "src/arch/arm64/Kconfig"
```

## rpi_bm/miniOS/src/arch/arm/Kconfig
```kconfig
menu "ARMv7 architecture"
    depends on ARCH_ARM
config CPU_CORTEX_A7
    bool "Cortex-A7"
    default y
endmenu
```

## rpi_bm/miniOS/src/arch/arm/configs/100ask_t113_defconfig
```kconfig
CONFIG_ARCH_ARM=y
CONFIG_BOARD_100ASK_T113=y
CONFIG_MMC=y
CONFIG_MMC_SUNXI=y
CONFIG_SDIO=y
CONFIG_NET=y
CONFIG_TFTP_CLIENT=y
CONFIG_WLAN=y
CONFIG_WLAN_XRADIO=y
CONFIG_WLAN_XRADIO_XR829=y
CONFIG_XR829_WSM=y
CONFIG_WPA2_PSK=y
CONFIG_I2C=y
CONFIG_VIDEO=n
CONFIG_VIDEO_OV5640=n
CONFIG_VFS=y
CONFIG_MINIFS=y
CONFIG_SYSFS=y
CONFIG_USERSPACE=y
CONFIG_DEBUG_MMU_DUMP=n
CONFIG_DEBUG_TIMER_TICK=n
```

## rpi_bm/miniOS/src/arch/arm64/Kconfig
```kconfig
menu "ARM64 architecture"
    depends on ARCH_ARM64
config CPU_CORTEX_A53
    bool "Cortex-A53"
    default y
endmenu
```

## rpi_bm/miniOS/src/arch/arm64/configs/rpi3_defconfig
```kconfig
CONFIG_ARCH_ARM64=y
CONFIG_BOARD_RPI3=y
CONFIG_MMC=n
CONFIG_SDIO=n
CONFIG_NET=n
CONFIG_WLAN=n
CONFIG_WLAN_XRADIO=n
CONFIG_WLAN_XRADIO_XR829=n
CONFIG_XR829_WSM=n
CONFIG_WPA2_PSK=n
CONFIG_I2C=y
CONFIG_VIDEO=y
CONFIG_VIDEO_OV5640=n
CONFIG_VFS=n
CONFIG_MINIFS=n
CONFIG_USERSPACE=y
CONFIG_DEBUG_MMU_DUMP=y
```

## rpi_bm/miniOS/src/boards/100ask_t113/Kconfig
```kconfig
menu "100ASK T113-S3 board"
    depends on BOARD_100ASK_T113
config SOC_T113
    bool
    default y
config T113_UART3
    bool "UART3 console"
    default y
config T113_TIMER0
    bool "Timer0 system tick"
    default y
endmenu
```

## rpi_bm/miniOS/src/boards/Kconfig
```kconfig
choice
    prompt "Target board"

config BOARD_100ASK_T113
    bool "100ASK T113-S3"
    depends on ARCH_ARM
config BOARD_RPI3
    bool "Raspberry Pi 3"
    depends on ARCH_ARM64
endchoice

source "src/boards/100ask_t113/Kconfig"
source "src/boards/raspberrypi/Kconfig"
```

## rpi_bm/miniOS/src/boards/raspberrypi/Kconfig
```kconfig
menu "Raspberry Pi board"
    depends on BOARD_RPI3
config SOC_BCM2837
    bool
    default y
endmenu
```

## rpi_bm/miniOS/src/drivers/Kconfig
```kconfig
menu "Device Drivers"
source "src/drivers/mmc/Kconfig"
source "src/drivers/net/Kconfig"
source "src/drivers/input/Kconfig"

config I2C
    bool "I2C support"
    default y if BOARD_100ASK_T113
config VIDEO
    bool "Video capture support"
    depends on I2C
    default n
config VIDEO_OV5640
    bool "OV5640 camera"
    depends on VIDEO
    default n
endmenu
```

## rpi_bm/miniOS/src/drivers/input/Kconfig
```kconfig
menu "Input device support"
config INPUT_GPIO_KEYS
    bool "GPIO buttons"
    depends on BOARD_100ASK_T113
    default y
endmenu
```

## rpi_bm/miniOS/src/drivers/mmc/Kconfig
```kconfig
menu "MMC/SD/SDIO"
config MMC
    bool "MMC core"
    default y if BOARD_100ASK_T113
config MMC_SUNXI
    bool "Allwinner SMHC host controller"
    depends on MMC && BOARD_100ASK_T113
    default y
config SDIO
    bool "SDIO bus"
    depends on MMC
    default y
endmenu
```

## rpi_bm/miniOS/src/drivers/net/Kconfig
```kconfig
menu "Network device support"
    depends on NET
source "src/drivers/net/wireless/Kconfig"
endmenu
```

## rpi_bm/miniOS/src/drivers/net/wireless/Kconfig
```kconfig
menu "Wireless LAN"
    depends on NET
config WLAN
    bool "Wireless LAN"
    default y
source "src/drivers/net/wireless/xradio/Kconfig"
endmenu
```

## rpi_bm/miniOS/src/drivers/net/wireless/xradio/Kconfig
```kconfig
menu "XRadio wireless support"
    depends on WLAN && SDIO && MAC80211
config WLAN_XRADIO
    bool "XRadio XR8xx support"
    default y if BOARD_100ASK_T113
config WLAN_XRADIO_XR829
    bool "XR829 SDIO device"
    depends on WLAN_XRADIO
    default y
config XR829_WSM
    bool "WSM firmware command layer"
    depends on WLAN_XRADIO_XR829
    default y
endmenu
```

## rpi_bm/miniOS/src/fs/Kconfig
```kconfig
menu "File systems"
config VFS
    bool "Virtual file system"
    default y
config MINIFS
    bool "Embedded miniFS"
    depends on VFS
    default y
config SYSFS
    bool "sysfs driver-model filesystem"
    depends on VFS
    default y if BOARD_100ASK_T113
endmenu
```

## rpi_bm/miniOS/src/net/Kconfig
```kconfig
menu "Networking support"
config NET
    bool "Networking support (core, Ethernet, IPv4/UDP/ICMP, DHCP)"
    default y if BOARD_100ASK_T113
config TFTP_CLIENT
    bool "TFTP client and miniBoot updater"
    depends on NET
    default y
source "src/net/wireless/Kconfig"
source "src/net/mac80211/Kconfig"
source "src/net/wpa/Kconfig"
endmenu
```

## rpi_bm/miniOS/src/net/mac80211/Kconfig
```kconfig
config MAC80211
    bool "Generic IEEE 802.11 stack (mac80211)"
    depends on CFG80211
    default y
```

## rpi_bm/miniOS/src/net/wireless/Kconfig
```kconfig
config CFG80211
    bool "cfg80211 - wireless configuration API"
    depends on NET
    default y
```

## rpi_bm/miniOS/src/net/wpa/Kconfig
```kconfig
config WPA2_PSK
    bool "In-kernel WPA2-PSK supplicant"
    depends on CFG80211
    default y
```
